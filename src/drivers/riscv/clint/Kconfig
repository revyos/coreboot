## src/drivers/riscv/clint/Kconfig
```kconfig
# SPDX-License-Identifier: GPL-2.0-only
config DRIVERS_RISCV_CLINT
	bool
	depends on ARCH_RISCV
	help
	  Match the CLINT compatible string to its counter and MMIO rules.
```

## src/drivers/spi/designware/Kconfig
```kconfig
# SPDX-License-Identifier: GPL-2.0-only
config DRIVERS_SPI_DESIGNWARE
	bool
	help
	  Polled 8-bit transfers on DesignWare SSI controllers. The platform
	  supplies chip-select handling, clocks and pad configuration.
```

## src/mainboard/milkv/Kconfig
```kconfig
# SPDX-License-Identifier: GPL-2.0-only
if VENDOR_MILKV
choice
	prompt "Mainboard model"
source "src/mainboard/milkv/*/Kconfig.name"
endchoice
source "src/mainboard/milkv/*/Kconfig"
config MAINBOARD_VENDOR
	default "Milk-V"
endif
```

## src/mainboard/milkv/meles/Kconfig
```kconfig
# SPDX-License-Identifier: GPL-2.0-only
if BOARD_MILKV_MELES
config BOARD_SPECIFIC_OPTIONS
	def_bool y
	select SOC_THEAD_TH1520
	select BOARD_ROMSIZE_KB_1024 if !MELES_NORMAL_FIRMWARE
	select BOARD_ROMSIZE_KB_2048 if MELES_NORMAL_FIRMWARE
	select MISSING_BOARD_RESET

config MAINBOARD_DIR
	default "milkv/meles"

config MAINBOARD_PART_NUMBER
	default "Meles"

config MELES_NORMAL_FIRMWARE
	bool "Build the full EDK2 storage image"
	help
	  Use a 2 MiB flash layout for the normal EDK2 payload and AON.
	  This image is for SPI or eMMC; RAM recovery uses the 1 MiB layout.

config FMDFILE
	default "src/mainboard/milkv/meles/board-normal.fmd" if MELES_NORMAL_FIRMWARE
	default "src/mainboard/milkv/meles/board.fmd"

config HEAP_SIZE
	default 0x80000 if TH1520_PAYLOAD_FDT
	default 0x10000
endif
```

## src/mainboard/sipeed/Kconfig
```kconfig
# SPDX-License-Identifier: GPL-2.0-only
if VENDOR_SIPEED
choice
	prompt "Mainboard model"
source "src/mainboard/sipeed/*/Kconfig.name"
endchoice
source "src/mainboard/sipeed/*/Kconfig"
config MAINBOARD_VENDOR
	default "Sipeed"
endif
```

## src/mainboard/sipeed/lpi4a/Kconfig
```kconfig
# SPDX-License-Identifier: GPL-2.0-only
if BOARD_SIPEED_LPI4A
config BOARD_SPECIFIC_OPTIONS
	def_bool y
	select SOC_THEAD_TH1520
	select BOARD_ROMSIZE_KB_1024 if !LPI4A_NORMAL_FIRMWARE
	select BOARD_ROMSIZE_KB_2048 if LPI4A_NORMAL_FIRMWARE
	select MISSING_BOARD_RESET

config MAINBOARD_DIR
	default "sipeed/lpi4a"

config MAINBOARD_PART_NUMBER
	default "Lichee Pi 4A"

config LPI4A_NORMAL_FIRMWARE
	bool "Build the full EDK2 storage image"
	help
	  Use a 2 MiB eMMC boot0 image for normal EDK2 and AON.
	  RAM recovery uses the separate 1 MiB layout.

config FMDFILE
	default "src/mainboard/sipeed/lpi4a/board-normal.fmd" if LPI4A_NORMAL_FIRMWARE
	default "src/mainboard/sipeed/lpi4a/board.fmd"

config HEAP_SIZE
	default 0x80000 if TH1520_PAYLOAD_FDT
	default 0x10000
endif
```

## src/mainboard/sipeed/lpi4a/Kconfig.name
```kconfig
# SPDX-License-Identifier: GPL-2.0-only
config BOARD_SIPEED_LPI4A
	bool "Lichee Pi 4A"
```

## src/mainboard/zhihe/Kconfig
```kconfig
# SPDX-License-Identifier: GPL-2.0-only
if VENDOR_ZHIHE
choice
	prompt "Mainboard model"
source "src/mainboard/zhihe/*/Kconfig.name"
endchoice
source "src/mainboard/zhihe/*/Kconfig"
config MAINBOARD_VENDOR
	default "Zhihe"
endif
```

## src/mainboard/zhihe/melonpi/Kconfig
```kconfig
# SPDX-License-Identifier: GPL-2.0-only
if BOARD_ZHIHE_MELONPI

config BOARD_SPECIFIC_OPTIONS
	def_bool y
	select SOC_ZHIHE_A210
	select MB_COMPRESS_RAMSTAGE_LZ4
	select BOARD_ROMSIZE_KB_2048 if A210_BOOT_RAM
	select BOARD_ROMSIZE_KB_2048 if A210_STORAGE_IMAGE
	select BOARD_ROMSIZE_KB_256 if !A210_FIRMWARE && !A210_BOOTSTRAP
	select MISSING_BOARD_RESET

config A210_STORAGE_IMAGE
	def_bool (A210_FIRMWARE || A210_BOOTSTRAP) && !A210_BOOT_RAM

config MAINBOARD_DIR
	default "zhihe/melonpi"

config MAINBOARD_PART_NUMBER
	default "Melon Pi V1" if MELONPI_V1
	default "Melon Pi V2" if MELONPI_V2

choice
	prompt "Melon Pi carrier revision"
	default MELONPI_V2
	help
	  Select the carrier explicitly. The module ADC straps describe
	  the memory configuration, not the carrier revision.

config MELONPI_V1
	bool "V1"

config MELONPI_V2
	bool "V2"

endchoice

config FMDFILE
	default "src/mainboard/zhihe/melonpi/ram.fmd" if A210_BOOT_RAM
	default "src/mainboard/zhihe/melonpi/board.fmd" if A210_STORAGE_IMAGE

# Leave room for the BootROM header inside the 2 MiB OCRAM.
config ROM_SIZE
	default 0x180000 if A210_BOOT_RAM

config COREBOOT_ROMSIZE_KB
	default 1536 if A210_BOOT_RAM

endif
```

## src/mainboard/zhihe/melonpi/Kconfig.name
```kconfig
# SPDX-License-Identifier: GPL-2.0-only
config BOARD_ZHIHE_MELONPI
	bool "Melon Pi"
```

## src/soc/thead/th1520/Kconfig
```kconfig
# SPDX-License-Identifier: GPL-2.0-only

config SOC_THEAD_TH1520
	bool
	select ARCH_RISCV_RV64
	select ARCH_RISCV_S
	select ARCH_RISCV_U
	select ARCH_RISCV_PMP
	select FLATTENED_DEVICE_TREE
	select ARCH_BOOTBLOCK_RISCV
	select ARCH_VERSTAGE_RISCV
	select ARCH_ROMSTAGE_RISCV
	select ARCH_RAMSTAGE_RISCV
	select DRIVERS_UART_8250MEM_32
	select UART_OVERRIDE_REFCLK
	select RISCV_HAS_OPENSBI
	select DRIVERS_RISCV_CLINT
	select BOOT_DEVICE_NOT_SPI_FLASH
	select SPI_FLASH
	select SPI_FLASH_DONT_INCLUDE_ALL_DRIVERS
	select SPI_FLASH_WINBOND
	select SPI_FLASH_GIGADEVICE
	select DRIVERS_SPI_DESIGNWARE
	select COMMONLIB_STORAGE
	select COMMONLIB_STORAGE_MMC
	select SDHCI_CONTROLLER

if SOC_THEAD_TH1520

config SEPARATE_ROMSTAGE
	default n

config MEMLAYOUT_LD_FILE
	default "src/soc/thead/th1520/memlayout.ld"

config RISCV_ARCH
	default "rv64imafdc"

config RISCV_ABI
	default "lp64d"

config RISCV_CODEMODEL
	default "medany"

config MAX_CPUS
	default 4

config RISCV_WORKING_HARTID
	default 0

config RISCV_SOC_HAS_MENVCFG
	default n

config OPENSBI_PLATFORM
	default "generic"

config OPENSBI_TEXT_START
	default 0x80000000

config OPENSBI_FW_DYNAMIC_BOOT_HART
	default -1

config TH1520_CPU_750MHZ
	bool "Initialize the CPU clock to 750 MHz"
	depends on !TH1520_AON
	default y
	help
	  Program the unused CPU PLL and switch with a 150 MHz bus clock.
	  This cold-boot setting leaves voltage control and OS DVFS unchanged.

config TH1520_AON
	bool "Start AON and request the 1.848 GHz CPU operating point"
	help
	  Load a board-configured E902 image, confirm its PMIC mailbox service,
	  request 1.0 V CPU rails and raise CPU frequency only after readback.

config TH1520_AON_FILE
	string "Board-configured AON firmware path"
	depends on TH1520_AON

choice
	prompt "TH1520 boot medium"
	default TH1520_BOOT_AUTO
config TH1520_BOOT_AUTO
	bool "Follow BootROM boot straps"
config TH1520_BOOT_RAM
	bool "RAM download image"
config TH1520_BOOT_SPI
	bool "SPI NOR"
config TH1520_BOOT_EMMC
	bool "eMMC boot0"
endchoice

config TH1520_PAYLOAD_FDT
	bool "Pass a board DTB to the OpenSBI payload"
	depends on RISCV_OPENSBI

config TH1520_PAYLOAD_DTB
	string "Payload DTB path"
	depends on TH1520_PAYLOAD_FDT

config TH1520_STORAGE_TEST
	bool "Read-only storage checks during RAM bring-up"
	default n

endif
```

## src/soc/zhihe/a210/Kconfig
```kconfig
# SPDX-License-Identifier: GPL-2.0-only
config SOC_ZHIHE_A210
	bool
	select ARCH_RISCV_RV64
	select ARCH_RISCV_S
	select ARCH_RISCV_U
	select ARCH_RISCV_PMP
	select ARCH_BOOTBLOCK_RISCV
	select ARCH_VERSTAGE_RISCV
	select ARCH_ROMSTAGE_RISCV
	select ARCH_RAMSTAGE_RISCV
	select HAVE_UART_SPECIAL
	select UART_OVERRIDE_REFCLK
	select DRIVERS_RISCV_CLINT
	select DRIVERS_I2C_DESIGNWARE
	select RISCV_HAS_OPENSBI
	select FLATTENED_DEVICE_TREE
if SOC_ZHIHE_A210
config A210_BOOTSTRAP
	bool "Build the small BootROM entry stage"
	select A210_EMMC if !A210_BOOT_RAM
	select BOOT_DEVICE_NOT_SPI_FLASH
	default n

config A210_FIRMWARE
	bool "Build complete coreboot firmware"
	select A210_EMMC
	select A210_DDR_TEST
	select BOOT_DEVICE_NOT_SPI_FLASH
	default n

config A210_BOOT_RAM
	bool "Receive the complete firmware through BootROM USB"
	default n

config A210_AON_FILE
	string "A210 AON firmware binary"
	depends on A210_FIRMWARE

config A210_PAYLOAD_DTB
	string "Payload device tree"
	depends on A210_FIRMWARE

config OPENSBI_PLATFORM
	default "generic"
config OPENSBI_TEXT_START
	default 0x80000000
config OPENSBI_FW_DYNAMIC_BOOT_HART
	default 0
config A210_EMMC
	bool
	select COMMONLIB_STORAGE
	select COMMONLIB_STORAGE_MMC
	select SDHCI_CONTROLLER

config A210_EMMC_TEST
	bool "Read-only eMMC diagnostics"
	select A210_EMMC
	default n

config A210_DDR_TEST
	bool "Include DDR training in the BRAM diagnostic"
	default n
	help
	  Includes dual-channel LPDDR4X training and memory tests.
	  This image requires JTAG loading; it exceeds the initial
	  BootROM USB download budget.
config DRIVERS_I2C_DESIGNWARE_CLOCK_MHZ
	default 24
config SEPARATE_ROMSTAGE
	default n
config MEMLAYOUT_LD_FILE
	default "src/soc/zhihe/a210/memlayout.ld"
config RISCV_ARCH
	default "rv64imafdc"
config RISCV_ABI
	default "lp64d"
config RISCV_CODEMODEL
	default "medany"
config MAX_CPUS
	default 1
config RISCV_WORKING_HARTID
	default 0
endif
```
